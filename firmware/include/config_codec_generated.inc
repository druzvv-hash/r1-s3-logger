// Generated by tools/generate_config.py; included inside namespace settings.
bool validate(const Config& c) {
    if (!(std::isfinite(c.shunt_uohm) && c.shunt_uohm >= 1 && c.shunt_uohm <= 1000000)) return false;
    if (!((c.polarity == -1 || c.polarity == 1))) return false;
    if (!(std::isfinite(c.i_zero_uV) && c.i_zero_uV >= -1000 && c.i_zero_uV <= 1000)) return false;
    if (!(std::isfinite(c.i_gain) && c.i_gain >= 0.5 && c.i_gain <= 2)) return false;
    if (!(std::isfinite(c.u_zero_V) && c.u_zero_V >= -10 && c.u_zero_V <= 10)) return false;
    if (!(std::isfinite(c.u_gain) && c.u_gain >= 0.5 && c.u_gain <= 2)) return false;
#if R1_BENCHMARK
    if (c.requested_rate_hz < 10 || c.requested_rate_hz > 1000) return false;
#else
    if (!((c.requested_rate_hz == 10 || c.requested_rate_hz == 50 || c.requested_rate_hz == 100))) return false;
#endif
    if (!((c.adc_range == 0 || c.adc_range == 1))) return false;
    if (!(c.vshunt_ct_code >= 0 && c.vshunt_ct_code <= 7)) return false;
    if (!(c.vbus_ct_code >= 0 && c.vbus_ct_code <= 7)) return false;
    if (!(c.temp_ct_code >= 0 && c.temp_ct_code <= 7)) return false;
    if (!(c.average_code >= 0 && c.average_code <= 7)) return false;
    if (!(c.ready_timeout_us >= 1000 && c.ready_timeout_us <= 1000000)) return false;
    if (!(c.max_gap_us >= 1000 && c.max_gap_us <= 1000000)) return false;
    if (!(c.flush_interval_ms >= 100 && c.flush_interval_ms <= 10000)) return false;
    if (!(c.queue_bytes >= 4096 && c.queue_bytes <= 1048576)) return false;
    if (!(c.rotation_bytes >= 1048576 && c.rotation_bytes <= 1073741824)) return false;
    if (!(c.reserve_bytes >= 1048576 && c.reserve_bytes <= 1073741824)) return false;
    if (!(c.display_hz >= 1 && c.display_hz <= 10)) return false;
    if (!(c.live_hz >= 1 && c.live_hz <= 10)) return false;
    if (!(c.display_filter_tau_ms >= 0 && c.display_filter_tau_ms <= 10000)) return false;
    if (!(c.display_utc_offset_min >= -720 && c.display_utc_offset_min <= 840)) return false;
    if (!(c.calibration_id.size() <= 64 && utf8(c.calibration_id))) return false;
    if (!(c.calibration_note.size() <= 256 && utf8(c.calibration_note))) return false;
    if (!(c.calibration_utc.size() <= 20 && utf8(c.calibration_utc))) return false;
    if (!(c.oled_contrast >= 0 && c.oled_contrast <= 255)) return false;
    return validDate(c.calibration_utc) && (!c.calibration_valid || (!c.calibration_id.empty() && !c.calibration_note.empty() && !c.calibration_utc.empty()));
}
Bytes encode(const Config& c) {
    Bytes out; if (!validate(c)) return out;
    append(out, 1, 3, c.shunt_uohm);
    append(out, 2, 2, c.polarity);
    append(out, 3, 3, c.i_zero_uV);
    append(out, 4, 3, c.i_gain);
    append(out, 5, 3, c.u_zero_V);
    append(out, 6, 3, c.u_gain);
    append(out, 7, 1, c.requested_rate_hz);
    append(out, 8, 1, c.adc_range);
    append(out, 9, 1, c.vshunt_ct_code);
    append(out, 10, 1, c.vbus_ct_code);
    append(out, 11, 1, c.temp_ct_code);
    append(out, 12, 1, c.average_code);
    append(out, 13, 1, c.ready_timeout_us);
    append(out, 14, 1, c.max_gap_us);
    append(out, 15, 1, c.flush_interval_ms);
    append(out, 16, 1, c.queue_bytes);
    append(out, 17, 1, c.rotation_bytes);
    append(out, 18, 1, c.reserve_bytes);
    append(out, 19, 4, c.allow_unknown_utc);
    append(out, 20, 1, c.display_hz);
    append(out, 21, 1, c.live_hz);
    append(out, 22, 1, c.display_filter_tau_ms);
    append(out, 23, 2, c.display_utc_offset_min);
    append(out, 24, 5, c.calibration_id);
    append(out, 25, 5, c.calibration_note);
    append(out, 26, 5, c.calibration_utc);
    append(out, 27, 4, c.calibration_valid);
    append(out, 28, 1, c.oled_contrast);
    return out;
}
bool decode(const Bytes& data, Config& result) {
    Config c; size_t pos=0;
    if (!take(data,pos,1,3,c.shunt_uohm)) return false;
    if (!take(data,pos,2,2,c.polarity)) return false;
    if (!take(data,pos,3,3,c.i_zero_uV)) return false;
    if (!take(data,pos,4,3,c.i_gain)) return false;
    if (!take(data,pos,5,3,c.u_zero_V)) return false;
    if (!take(data,pos,6,3,c.u_gain)) return false;
    if (!take(data,pos,7,1,c.requested_rate_hz)) return false;
    if (!take(data,pos,8,1,c.adc_range)) return false;
    if (!take(data,pos,9,1,c.vshunt_ct_code)) return false;
    if (!take(data,pos,10,1,c.vbus_ct_code)) return false;
    if (!take(data,pos,11,1,c.temp_ct_code)) return false;
    if (!take(data,pos,12,1,c.average_code)) return false;
    if (!take(data,pos,13,1,c.ready_timeout_us)) return false;
    if (!take(data,pos,14,1,c.max_gap_us)) return false;
    if (!take(data,pos,15,1,c.flush_interval_ms)) return false;
    if (!take(data,pos,16,1,c.queue_bytes)) return false;
    if (!take(data,pos,17,1,c.rotation_bytes)) return false;
    if (!take(data,pos,18,1,c.reserve_bytes)) return false;
    if (!take(data,pos,19,4,c.allow_unknown_utc)) return false;
    if (!take(data,pos,20,1,c.display_hz)) return false;
    if (!take(data,pos,21,1,c.live_hz)) return false;
    if (!take(data,pos,22,1,c.display_filter_tau_ms)) return false;
    if (!take(data,pos,23,2,c.display_utc_offset_min)) return false;
    if (!take(data,pos,24,5,c.calibration_id)) return false;
    if (!take(data,pos,25,5,c.calibration_note)) return false;
    if (!take(data,pos,26,5,c.calibration_utc)) return false;
    if (!take(data,pos,27,4,c.calibration_valid)) return false;
    if (!take(data,pos,28,1,c.oled_contrast)) return false;
    if (pos != data.size() || !validate(c)) return false;
    result=c; return true;
}
