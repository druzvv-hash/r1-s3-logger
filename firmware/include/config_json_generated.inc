// Generated by tools/generate_config.py; included inside configJson.
s += "\"adc_range\":" + integer(c.adc_range);
s += ",\"allow_unknown_utc\":" + std::string(c.allow_unknown_utc ? "true" : "false");
s += ",\"average_code\":" + integer(c.average_code);
s += ",\"calibration_id\":" + jsonQuote(c.calibration_id);
s += ",\"calibration_note\":" + jsonQuote(c.calibration_note);
s += ",\"calibration_utc\":" + jsonQuote(c.calibration_utc);
s += ",\"calibration_valid\":" + std::string(c.calibration_valid ? "true" : "false");
s += ",\"display_filter_tau_ms\":" + integer(c.display_filter_tau_ms);
s += ",\"display_hz\":" + integer(c.display_hz);
s += ",\"display_utc_offset_min\":" + signedInteger(c.display_utc_offset_min);
s += ",\"flush_interval_ms\":" + integer(c.flush_interval_ms);
s += ",\"i_gain\":" + real(c.i_gain);
s += ",\"i_zero_uV\":" + real(c.i_zero_uV);
s += ",\"live_hz\":" + integer(c.live_hz);
s += ",\"max_gap_us\":" + integer(c.max_gap_us);
s += ",\"oled_contrast\":" + integer(c.oled_contrast);
s += ",\"polarity\":" + signedInteger(c.polarity);
s += ",\"queue_bytes\":" + integer(c.queue_bytes);
s += ",\"ready_timeout_us\":" + integer(c.ready_timeout_us);
s += ",\"requested_rate_hz\":" + integer(c.requested_rate_hz);
s += ",\"reserve_bytes\":" + integer(c.reserve_bytes);
s += ",\"rotation_bytes\":" + integer(c.rotation_bytes);
s += ",\"shunt_uohm\":" + real(c.shunt_uohm);
s += ",\"temp_ct_code\":" + integer(c.temp_ct_code);
s += ",\"u_gain\":" + real(c.u_gain);
s += ",\"u_zero_V\":" + real(c.u_zero_V);
s += ",\"vbus_ct_code\":" + integer(c.vbus_ct_code);
s += ",\"vshunt_ct_code\":" + integer(c.vshunt_ct_code);
